/*
 * rtd-119x-hdmirxEDID.dtsi - HDMI Rx EDID table for REALTEK 119X family SoC
 */

/*/include/ "skeleton.dtsi"*/

/ {
	hdmirx@1800F000 {
		Realtek,ddc-max-num = <1>;	//Currently, 119x only support 1 DDC channel
		Realtek,edid-used-mask = <0x00000001>;	//Which EDID tables are used. For this example, we use edid-tbl0. if the value is 0x00000003, that means we use edid-tbl0 and edid-tbl1.

		Realtek,edid-tbl0 = <
			0x00 0xFF 0xFF 0xFF 0xFF 0xFF 0xFF 0x00 0x4A 0x8B 0x54 0x4C 0x01 0x00 0x00 0x00
			0x0C 0x11 0x01 0x03 0x81 0x46 0x27 0x78 0x8A 0xA5 0x8E 0xA6 0x54 0x4A 0x9C 0x26
			0x12 0x45 0x46 0xAD 0xCE 0x00 0x81 0x40 0x01 0x01 0x01 0x01 0x01 0x01 0x01 0x01
			0x01 0x01 0x01 0x01 0x01 0x01 0x01 0x1D 0x00 0x72 0x51 0xD0 0x1E 0x20 0x6E 0x28
			0x55 0x00 0xB9 0x88 0x21 0x00 0x00 0x1E 0x9A 0x29 0xA0 0xD0 0x51 0x84 0x22 0x30
			0x50 0x98 0x36 0x00 0xB9 0x88 0x21 0x00 0x00 0x1C 0x00 0x00 0x00 0xFD 0x00 0x32
			0x4B 0x18 0x3C 0x0B 0x00 0x0A 0x20 0x20 0x20 0x20 0x20 0x20 0x00 0x00 0x00 0xFC
			0x00 0x33 0x32 0x56 0x33 0x48 0x2D 0x48 0x36 0x41 0x0A 0x20 0x20 0x20 0x01 0xE3
			0x02 0x03 0x21 0x61 0x83 0x01 0x00 0x00 0x65 0x03 0x0C 0x00 0x10 0x00 0x4E 0x06
			0x07 0x02 0x03 0x15 0x96 0x11 0x12 0x13 0x04 0x14 0x05 0x1F 0x90 0x23 0x09 0x7F
			0x07 0x8C 0x0A 0xD0 0x90 0x20 0x40 0x31 0x20 0x0C 0x40 0x55 0x00 0xB9 0x88 0x21
			0x00 0x00 0x18 0x01 0x1D 0x80 0x18 0x71 0x1C 0x16 0x20 0x58 0x2C 0x25 0x00 0xB9
			0x88 0x21 0x00 0x00 0x9E 0x01 0x1D 0x80 0xD0 0x72 0x1C 0x16 0x20 0x10 0x2C 0x25
			0x80 0xB9 0x88 0x21 0x00 0x00 0x9E 0x01 0x1D 0x00 0xBC 0x52 0xD0 0x1E 0x20 0xB8
			0x28 0x55 0x40 0xB9 0x88 0x21 0x00 0x00 0x1E 0x02 0x3A 0x80 0xD0 0x72 0x38 0x2D
			0x40 0x10 0x2C 0x45 0x80 0xB9 0x88 0x21 0x00 0x00 0x1E 0x00 0x00 0x00 0x00 0x68
		>;
		/*Realtek,edid-tbl1 = <
			0x00 0xFF 0xFF 0xFF 0xFF 0xFF 0xFF 0x00 0x4A 0x8B 0x54 0x4C 0x01 0x00 0x00 0x00
			0x0C 0x11 0x01 0x03 0x81 0x46 0x27 0x78 0x8A 0xA5 0x8E 0xA6 0x54 0x4A 0x9C 0x26
			0x12 0x45 0x46 0xAD 0xCE 0x00 0x81 0x40 0x01 0x01 0x01 0x01 0x01 0x01 0x01 0x01
			0x01 0x01 0x01 0x01 0x01 0x01 0x01 0x1D 0x00 0x72 0x51 0xD0 0x1E 0x20 0x6E 0x28
			0x55 0x00 0xB9 0x88 0x21 0x00 0x00 0x1E 0x9A 0x29 0xA0 0xD0 0x51 0x84 0x22 0x30
			0x50 0x98 0x36 0x00 0xB9 0x88 0x21 0x00 0x00 0x1C 0x00 0x00 0x00 0xFD 0x00 0x32
			0x4B 0x18 0x3C 0x0B 0x00 0x0A 0x20 0x20 0x20 0x20 0x20 0x20 0x00 0x00 0x00 0xFC
			0x00 0x33 0x32 0x56 0x33 0x48 0x2D 0x48 0x36 0x41 0x0A 0x20 0x20 0x20 0x01 0xE3
			0x02 0x03 0x21 0x61 0x83 0x01 0x00 0x00 0x65 0x03 0x0C 0x00 0x10 0x00 0x4E 0x06
			0x07 0x02 0x03 0x15 0x96 0x11 0x12 0x13 0x04 0x14 0x05 0x1F 0x90 0x23 0x09 0x7F
			0x07 0x8C 0x0A 0xD0 0x90 0x20 0x40 0x31 0x20 0x0C 0x40 0x55 0x00 0xB9 0x88 0x21
			0x00 0x00 0x18 0x01 0x1D 0x80 0x18 0x71 0x1C 0x16 0x20 0x58 0x2C 0x25 0x00 0xB9
			0x88 0x21 0x00 0x00 0x9E 0x01 0x1D 0x80 0xD0 0x72 0x1C 0x16 0x20 0x10 0x2C 0x25
			0x80 0xB9 0x88 0x21 0x00 0x00 0x9E 0x01 0x1D 0x00 0xBC 0x52 0xD0 0x1E 0x20 0xB8
			0x28 0x55 0x40 0xB9 0x88 0x21 0x00 0x00 0x1E 0x02 0x3A 0x80 0xD0 0x72 0x38 0x2D
			0x40 0x10 0x2C 0x45 0x80 0xB9 0x88 0x21 0x00 0x00 0x1E 0x00 0x00 0x00 0x00 0x68
		>;
		Realtek,edid-tbl2 = <
			0x00 0xFF 0xFF 0xFF 0xFF 0xFF 0xFF 0x00 0x4A 0x8B 0x54 0x4C 0x01 0x00 0x00 0x00
			0x0C 0x11 0x01 0x03 0x81 0x46 0x27 0x78 0x8A 0xA5 0x8E 0xA6 0x54 0x4A 0x9C 0x26
			0x12 0x45 0x46 0xAD 0xCE 0x00 0x81 0x40 0x01 0x01 0x01 0x01 0x01 0x01 0x01 0x01
			0x01 0x01 0x01 0x01 0x01 0x01 0x01 0x1D 0x00 0x72 0x51 0xD0 0x1E 0x20 0x6E 0x28
			0x55 0x00 0xB9 0x88 0x21 0x00 0x00 0x1E 0x9A 0x29 0xA0 0xD0 0x51 0x84 0x22 0x30
			0x50 0x98 0x36 0x00 0xB9 0x88 0x21 0x00 0x00 0x1C 0x00 0x00 0x00 0xFD 0x00 0x32
			0x4B 0x18 0x3C 0x0B 0x00 0x0A 0x20 0x20 0x20 0x20 0x20 0x20 0x00 0x00 0x00 0xFC
			0x00 0x33 0x32 0x56 0x33 0x48 0x2D 0x48 0x36 0x41 0x0A 0x20 0x20 0x20 0x01 0xE3
			0x02 0x03 0x21 0x61 0x83 0x01 0x00 0x00 0x65 0x03 0x0C 0x00 0x10 0x00 0x4E 0x06
			0x07 0x02 0x03 0x15 0x96 0x11 0x12 0x13 0x04 0x14 0x05 0x1F 0x90 0x23 0x09 0x7F
			0x07 0x8C 0x0A 0xD0 0x90 0x20 0x40 0x31 0x20 0x0C 0x40 0x55 0x00 0xB9 0x88 0x21
			0x00 0x00 0x18 0x01 0x1D 0x80 0x18 0x71 0x1C 0x16 0x20 0x58 0x2C 0x25 0x00 0xB9
			0x88 0x21 0x00 0x00 0x9E 0x01 0x1D 0x80 0xD0 0x72 0x1C 0x16 0x20 0x10 0x2C 0x25
			0x80 0xB9 0x88 0x21 0x00 0x00 0x9E 0x01 0x1D 0x00 0xBC 0x52 0xD0 0x1E 0x20 0xB8
			0x28 0x55 0x40 0xB9 0x88 0x21 0x00 0x00 0x1E 0x02 0x3A 0x80 0xD0 0x72 0x38 0x2D
			0x40 0x10 0x2C 0x45 0x80 0xB9 0x88 0x21 0x00 0x00 0x1E 0x00 0x00 0x00 0x00 0x68
		>;*/
	};
};

