## linux-kernel/arch/arm/mach-rtk119x/Kconfig
```kconfig
comment "Realtek Platform Type"
choice
	prompt "Realtek Platform Type"
	depends on ARCH_RTK119X
	default MACH_RTK1195

config MACH_RTK1192
	bool "1192 EVB board"
	select PCI
	select ARCH_SUPPORTS_MSI
	select ARM_GIC if ARCH_RTK119X
	help
	  Support for Realtek 1192 EVB board

config MACH_RTK1195
	bool "1195 board"
	select ARM_GIC if ARCH_RTK119X
	select ARCH_HAS_BARRIERS
	help
	  Support for Realtek 1195 board
endchoice

menu "Realtek Platform Driver"

config REALTEK_PCIE
	depends on PCI
	bool "PCI-E host controller driver"
	help
	  Realtek PCI-E host controller driver

config RTK_MCP
	bool "MCP driver"
	help
	  Content Protection driver

config RTK_TIMER
	bool "Timer driver"
	default y
	help
	  Realtek Timer driver

config RTK_WATCHDOG
	bool "Watchdog driver"
	default n
	help
	  Realtek Watchdog driver

config RTK_WATCHDOG_ENABLE_TIMER
	bool "Enable watchdog hw reset timer"
	depends on RTK_WATCHDOG
	default n
	help
	  Enable watchdog hw reset timer

config UIO_RTK_RBUS
	bool "Memory mapping RBUS area to userspace"
	default n
    select UIO
    select UIO_ASSIGN_MINOR
	help
	  Memory mapping RBUS area to userspace

config UIO_RTK_REFCLK
	bool "Memory mapping Reference Clock area to userspace"
	default n
    select UIO
    select UIO_ASSIGN_MINOR
	help
	  Memory mapping Reference Clock area to userspace

config RTK_SE
	bool "Streaming Engine driver"
	default n
	help
	  Realtek Streaming Engine driver

config RTK_VFD
	bool "VFD driver"
	default n
	help
	  Realtek VFD driver

config UIO_RTK_SE
	bool "Streaming Engine driver use UIO mode"
	default n
    select UIO
    select UIO_ASSIGN_MINOR
	select CONFIG_UIO_PDRV_GENIRQ
	select CONFIG_UIO_DMEM_GENIRQ
	help
	  Realtek Streaming Engine driver use UIO mode
	  
config UIO_RTK_MD
	bool "Moving Data Engine driver use UIO mode"
	default n
    select UIO
    select UIO_ASSIGN_MINOR
	select CONFIG_UIO_PDRV_GENIRQ
	select CONFIG_UIO_DMEM_GENIRQ
	help
	  Realtek Moving Data Engine driver use UIO mode

config RTK_MD
	bool "Moving Data Engine(DMA) driver"
	default n
	help
	  Realtek Moving Data Engine(DMA) driver

config RTK_KMD
	bool "KMD(DMA) driver"
	default n
	help
	  KMD driver for kernel API

config RTK_RTC
	bool "RTC driver"
	default n
	help
	  Realtek RTC driver

config RTK_FB
	bool "Frame Buffer driver"
	select SYNC
	select SW_SYNC
	select SW_SYNC_USER
	default y
	help
	  Realtek Frame Buffer driver

config RTK_RPC
	bool "RPC driver"
	default n
	help
	  Realtek RPC driver with audio CPU

config REALTEK_AVCPU
        bool "AVCPU driver"
        default n
        help
          Realtek avcpu driver

config RTK_BT_RESET
        bool "Bluetooth RFKILL driver"
        default n
        help
          Realtek Bluetooth rfkill driver

config RTK_SB2_MEM_TRASH_MONITOR
        bool "Memory trash monitor"
        default n
        help
          Enable helper functions for memory trash detection. If unsure, say N.

config RTK_MON_GPIO
	bool "Monitor GPIO input"
	default n
	help
	  Enable to monitor input GPIO.

config USB_XHCI_HCD_TEST_MODE
	bool "XHCI test mode"
	default n
	help
	  Enable XHCI testing mode.

config USB_ERRATA_43575
	bool "XHCI+RTS5401 with USB2.0 device can't identify"
	default y
	help
	  USB3 MAC at U2 mode, DPHY handshake fail while suspend & resume ops

config USB_ERRATA_43576
	bool "XHCI+RTS5401, USB3.0 device can't identify with short line"
	default y
	help
	  EQ value need to trim at different line

config RTK_V1_ST
	bool "Debug V1 status"
	default y
	help
	  Display V1 status via a device node

source "arch/arm/mach-rtk119x/driver/Kconfig"
source "arch/arm/mach-rtk119x/driver/rtk_ve/Kconfig"

endmenu

menu "Realtek NAS support"
	depends on ARCH_RTK119X

config SENDFILE_PATCH
	bool "Reverse sendfile patch"
	default n
	help
	Use patched sendfile syscall to improve write performance on NAS.

config ENABLE_FAT_FALLOCATE
	bool "Enable fallocate on FAT"
	default n
	help
	Improve write performance on FAT partitions.

config MTD_NAND_DISC
	bool "Enable MTD disc for NAND"
	default n
	help
	Add last mtd partition(disc) to access whole MTD NAND flash.
        This special partition keeps the numeric suffix in dev name for
        mtd-util compatibility.

endmenu
```

## linux-kernel/arch/arm/mach-rtk119x/driver/Kconfig
```kconfig
menu "Uncatalogued drivers"
	depends on ARCH_RTK119X


config REALTEK_IR
        tristate "IR Receiver Driver"
        depends on ARCH_RTK119X
        default y
        help
          IR Receiver Character Device Driver


 
if REALTEK_IR

config SUPPORT_INPUT_DEVICE
	bool "Support IR Input Device"
	depends on REALTEK_IR
	help
	  IR Input Device Support

config SUPPORT_IRTX
	bool "Support IR TX"
	depends on REALTEK_IR
	help
	  IR TX Support


config YK_54LU
	bool "Support Skyworth TV Remote Controller"
	depends on REALTEK_IR
	default n
	help
	  Skyworth TV Remote Controller

config RTK_MK5_2
	bool "Support Realtek DTV Controller"
	depends on REALTEK_IR
	default n
	help
	  Realtek DTV Remote Controller

endif


config REALTEK_GPIO
        tristate "GPIO Driver"
        depends on ARCH_RTK119X
	select ARCH_REQUIRE_GPIOLIB
        default n
        help
          GPIO Device Driver
endmenu
```

## linux-kernel/drivers/cec/Kconfig
```kconfig
#Copyright (C) 2007-2013 Realtek Semiconductor Corporation.
# drivers/cec/Kconfig

source drivers/cec/core/Kconfig
source drivers/cec/adapter/Kconfig
source drivers/cec/adapter/rx/Kconfig

	
```

## linux-kernel/drivers/cec/adapter/Kconfig
```kconfig
#Copyright (C) 2007-2013 Realtek Semiconductor Corporation.
# drivers/Kconfig

menu "CEC0 Adapters"	
	depends on CEC

config RTD1195_CECTX
	tristate "CEC Controller 0 for Realtek RTD1195 platform"
	depends on CEC 
	default y
	help
	  Say Y, if you want to enable CEC0 feature on Realtek RTD1195 platform.

endmenu
```

## linux-kernel/drivers/cec/adapter/rx/Kconfig
```kconfig
#Copyright (C) 2007-2013 Realtek Semiconductor Corporation.
# drivers/Kconfig

menu "CEC1 Adapters"	
	depends on CEC

config RTD1195_CECRX
	tristate "CEC Controller 1 for Realtek RTD1195 platform"
	depends on CEC 
	default y
	help
	  Say Y, if you want to enable CEC1 feature on Realtek RTD1195 platform.
	  
endmenu
```

## linux-kernel/drivers/hdmirx/Kconfig
```kconfig
config HDMI_RX
	tristate "hdmi rx"
	select MEDIA_SUPPORT
	select MEDIA_CAMERA_SUPPORT
	select VIDEO_DEV
	select I2C
	select VIDEO_V4L2
	select VIDEOBUF2_CORE
	select VIDEOBUF_GEN
	select VIDEOBUF2_VMALLOC
	select VIDEOBUF2_DMA_CONTIG
	default N
	help
	  Add Hdmi RX driver.
```

## linux-kernel/drivers/lsadc/Kconfig
```kconfig
menuconfig LSADC
	bool "LSADC Support"
	help
	  Low speed ADC support.

	  If unsure, say no.

if LSADC

config RTK_LSADC
	tristate "Realtek RTD1195 LSADC support"
	depends on ARCH_RTK119X
	default y
	help
	  Say Y, if you want to enable LSADC feature on Realtek RTD1195 platform.
	  
endif
```

## linux-kernel/drivers/media/platform/rtk_hdcp/Kconfig
```kconfig
#Copyright (C) 2007-2014 Realtek Semiconductor Corporation.
# drivers/Kconfig

config RTK_HDCP_1x
	tristate "HDCP 1.x for Realtek RTD1195 platform"
	select I2C
	select SWITCH
	default n
	help
	  Say Y, if you want to enable HDCP 1.x feature on Realtek RTD1195 platform.
```

## linux-kernel/drivers/media/platform/rtk_hdmitx/Kconfig
```kconfig
#Copyright (C) 2007-2013 Realtek Semiconductor Corporation.
# drivers/Kconfig

config RTK_HDMITX
	tristate "HDMITX for Realtek RTD1195 platform"
	select I2C
	select SWITCH
	default n
	help
	  Say Y, if you want to enable HDMITX feature on Realtek RTD1195 platform.
```

## linux-kernel/drivers/mmc/Kconfig
```kconfig
#
# MMC subsystem configuration
#

menuconfig MMC
	tristate "MMC/SD/SDIO card support"
	depends on HAS_IOMEM
	help
	  This selects MultiMediaCard, Secure Digital and Secure
	  Digital I/O support.

	  If you want MMC/SD/SDIO support, you should say Y here and
	  also to your specific host controller driver.

config MMC_DEBUG
	bool "MMC debugging"
	depends on MMC != n
	help
	  This is an option for use by developers; most people should
	  say N here.  This enables MMC core and driver debugging.

config MMC_RTKEMMC
	bool "MMC RTK emmc"
	help
	  Support RealTek EMMC for Phoenix.

config MMC_FOR_RTK_FPGA
	bool "MMC RTK EMMC/SD/SDIO runs on FPGA b/d"
	help
	  Support RealTek EMMC/SD/SDIO for Phoenix FPGA b/d.

menuconfig MMC_RTKSD
	tristate "MMC RTK SD"
	help
	  Support RealTek SD for Phoenix.
	  
config MMC_RTKSD_INTERRUPT
	bool "Interrupt Mode"
	default y
	depends on MMC_RTKSD
	help
	  RTK SD Card Reader Interrupt Mode

if MMC

source "drivers/mmc/core/Kconfig"

source "drivers/mmc/card/Kconfig"

source "drivers/mmc/host/Kconfig"

endif # MMC
```
